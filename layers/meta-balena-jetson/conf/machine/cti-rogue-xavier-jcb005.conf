## layers/meta-balena-jetson/conf/machine/cti-rogue-xavier-jcb005.conf
```bitbake
#@TYPE: Machine
##@NAME: cti-rogue-xavier-jcb005
##@DESCRIPTION: Machine configuration for the CTI Rogue Carrier Board for NVidia Jetson Xavier

MACHINEOVERRIDES = "cti-rogue-xavier:${MACHINE}"
include conf/machine/cti-rogue-xavier.conf

MACHINEOVERRIDES := "${@'${MACHINEOVERRIDES}'.replace(':${MACHINE}',':cti-rogue-xavier:${MACHINE}')}"
```
